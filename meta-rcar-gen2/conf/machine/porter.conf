## meta-rcar-gen2/conf/machine/porter.conf
```bitbake
#@TYPE: Machine
#@NAME: porter
#@DESCRIPTION: Machine configuration for porter systems

require conf/machine/include/r8a7791.inc
require conf/machine/include/rcar-gen2-providers.inc

MACHINE_EXTRA_RRECOMMENDS = " kernel-modules"

MACHINE_ESSENTIAL_EXTRA_RRECOMMENDS += "kernel-module-mostcore \
					kernel-module-aim-cdev \
					kernel-module-aim-sound \
					kernel-module-aim-v4l2 \
					kernel-module-aim-network \
					kernel-module-hdm-dim2 \
					kernel-module-hdm-i2c \
					kernel-module-hdm-usb \
				       "


IMAGE_FSTYPES += "tar.bz2"

SERIAL_CONSOLE = "38400 ttySC6"

KERNEL_DEVICETREE = "${S}/arch/arm/boot/dts/r8a7791-porter.dts"

KERNEL_EXTRA_ARGS += "LOADADDR=${UBOOT_ENTRYPOINT}"

UBOOT_MACHINE = "porter_config"
UBOOT_ENTRYPOINT = "0x40008000"
UBOOT_LOADADDRESS = "0x40007fc0"

PREFERRED_VERSION_linux-renesas = "3.10%"
PREFERRED_VERSION_linux-libc-headers = "3.10%"
PREFERRED_VERSION_nativesdk-linux-libc-headers = "3.10%"
PREFERRED_VERSION_u-boot = "v2013.01%"

MACHINE_FEATURES = "apm usbgadget usbhost vfat alsa ethernet"
```
